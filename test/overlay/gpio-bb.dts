/dts-v1/;
/plugin/;

/ {
    fragment@0 {
        target-path = "/";
        __overlay__ {
            gpio0_bb: gpio_bb0@4804C000 {
                compatible = "gpio-bb";
                reg = <0x4804C000 0x1000>;
                clocks = <&l4ls_clkctrl 0x74 0>,
				<&l4ls_clkctrl 0x74 18>;
			    clock-names = "fck", "dbclk";
                interrupts = <98>, <99>;
                ngpios = <32>;
                status = "okay";
            };
        };
    };

    fragment@1 {
        target = <&gpio1>;
        __overlay__ {
                status = "disabled";
        };
    };
};













